## CMakeLists.txt
```
# SPDX-License-Identifier: Apache-2.0
cmake_minimum_required(VERSION 3.20.0)
find_package(Zephyr REQUIRED HINTS $ENV{ZEPHYR_BASE})
project(fcc_app)

target_sources(app PRIVATE
    src/main.c
    src/transport/uart_rx.c
    src/protocol/frame_parser.c
    src/common/ring_buffer.c
    src/application/frame_handler.c
    src/protocol/radar_message.c
    src/tracking/kalman_cv.c
    src/tracking/gating.c
    src/tracking/angle_utils.c
    src/tracking/track.c
    src/transport/rx_frame_processor.c
    src/transport/uart_tx.c
    src/protocol/protocol_frame.c
    src/common/crc16.c
    src/protocol/status_message.c
)

# Resolve module-qualified includes from the application source root.
target_include_directories(app PRIVATE ${CMAKE_CURRENT_SOURCE_DIR}/src)

# Bench-only producer; excluded from normal and ordinary debug firmware.
target_sources_ifdef(CONFIG_RADAR_LOG_STRESS_TEST app PRIVATE tests/log_stress/log_stress.c)
```

## Kconfig
```
mainmenu "Radar tracking firmware"

# Zephyr platform, board, driver, and kernel configuration definitions.
# The build command selects the board; its defconfig supplies board defaults.
source "Kconfig.zephyr"

# Application tuning options; select values in prj.conf.
menu "Radar application settings"

# RX buffer recovery policy.
choice RADAR_RX_OVERFLOW_POLICY
    prompt "RX overflow recovery policy"
    default RADAR_RX_OVERFLOW_DRAIN

config RADAR_RX_OVERFLOW_DRAIN
    bool "Drain buffered frames"
    help
        Process frames that can be completed from buffered bytes,
        then discard any remaining partial frame.

config RADAR_RX_OVERFLOW_DISCARD
    bool "Discard all buffered data"
    help
        Discard all buffered bytes and reset partial frame assembly.

endchoice

# Independent timeout limits, expressed in milliseconds.
config RADAR_FRAME_RX_TIMEOUT_MS
    int "Partial frame timeout (ms)"
    range 1 60000
    default 1000
    help
        Reset an incomplete frame when no further byte is processed
        within this interval. Idle parsers are not monitored.

config RADAR_MEASUREMENT_TIMEOUT_MS
    int "Radar measurement timeout (ms)"
    range 1 60000
    default 1000
    help
        Clear the track when no decoded and validated measurement
        is received within this interval. Monitoring starts only
        after the first valid measurement.

# Rectangular measurement gates: maximum absolute errors, not full window widths.
config RADAR_RANGE_GATE_M
    int "Range gate half-width (m)"
    range 1 65535
    default 100
    help
        Accept a measurement only when its absolute range error is at most
        this value in meters. The angular gate must also pass.
        This is a fixed threshold, not a covariance-based gate.

config RADAR_AZIMUTH_GATE_DEG
    int "Azimuth gate half-width (degrees)"
    range 1 180
    default 10
    help
        Maximum absolute wrapped angular error, including the boundary.
        Configuration uses whole degrees; calculations use radians.
        At 180 degrees every finite normalized angular error passes,
        but the range gate still applies.

# Generate per-module log levels and their OFF/ERR/WRN/INF/DBG choices.
# Select a choice in prj.conf or debug.conf; do not assign the derived integer.
# The template depends on LOG and uses LOG_DEFAULT_LEVEL for its Default choice.
menu "Application logging"
module = RADAR_MAIN
module-str = Radar startup
source "subsys/logging/Kconfig.template.log_config"

module = RADAR_UART_RX
module-str = Radar UART RX
source "subsys/logging/Kconfig.template.log_config"

module = RADAR_RX_PROCESSOR
module-str = Radar RX frame processor
source "subsys/logging/Kconfig.template.log_config"

module = RADAR_UART_TX
module-str = Radar UART TX
source "subsys/logging/Kconfig.template.log_config"

module = RADAR_HANDLER
module-str = Radar frame handler
source "subsys/logging/Kconfig.template.log_config"
endmenu

config RADAR_LOG_STRESS_TEST
    bool "Run a bounded log saturation test after boot"
    depends on LOG_MODE_DEFERRED && LOG_PROCESS_THREAD && ASSERT
    default n
    help
        Bench testing only. Generate numbered log bursts once after boot
        to exercise log-buffer exhaustion while UART traffic continues.
        Do not enable in normal firmware. See tests/log_stress/README.md.

endmenu
```

## prj.conf
```kconfig
# Normal firmware configuration; debug.conf adds assertions and debug logging.

# Platform drivers and console support.
CONFIG_SERIAL=y
CONFIG_CONSOLE=y
CONFIG_UART_CONSOLE=y
CONFIG_PRINTK=y
CONFIG_UART_INTERRUPT_DRIVEN=y
CONFIG_CBPRINTF_FP_SUPPORT=y

# Application recovery policy and timeout values (milliseconds).
CONFIG_RADAR_RX_OVERFLOW_DRAIN=y
CONFIG_RADAR_FRAME_RX_TIMEOUT_MS=1000
CONFIG_RADAR_MEASUREMENT_TIMEOUT_MS=1000

# Inclusive gate half-widths: +/- meters and +/- whole degrees around prediction.
CONFIG_RADAR_RANGE_GATE_M=100
CONFIG_RADAR_AZIMUTH_GATE_DEG=10

# Enable Zephyr logging. Deferred mode buffers messages before formatting/output.
CONFIG_LOG=y
CONFIG_LOG_MODE_DEFERRED=y
# Let Zephyr create the worker that processes buffered log messages.
CONFIG_LOG_PROCESS_THREAD=y
# Use the console UART (ST-Link), not the USART6 protocol data link.
CONFIG_LOG_BACKEND_UART=y
# Redirect remaining printk calls through logging. They are not module-filtered.
CONFIG_LOG_PRINTK=y

# Compile application error, warning, and info logs; omit debug logs.
CONFIG_RADAR_MAIN_LOG_LEVEL_INF=y
CONFIG_RADAR_UART_RX_LOG_LEVEL_INF=y
CONFIG_RADAR_RX_PROCESSOR_LOG_LEVEL_INF=y
CONFIG_RADAR_HANDLER_LOG_LEVEL_INF=y
CONFIG_RADAR_UART_TX_LOG_LEVEL_INF=y

# Allocate 4096 bytes for log messages, separate from RX/TX queues and stacks.
# This is a starting size, not a guarantee against log loss under load.
CONFIG_LOG_BUFFER_SIZE=4096

# Do not wait for free log-buffer space in application threads.
CONFIG_LOG_BLOCK_IN_THREAD=n
# On allocation failure, drop the new log instead of evicting older logs.
# This policy affects diagnostic logs, not the UART RX overflow policy.
CONFIG_LOG_MODE_OVERFLOW=n
```

## debug.conf
```kconfig
# Debug-only overlay: merge with prj.conf using -DEXTRA_CONF_FILE=debug.conf.
# Use a separate build directory to keep the normal build configuration unchanged.

# Enable runtime assertions for application and Zephyr code.
CONFIG_ASSERT=y

# Level 2 enables assertions without per-file preprocessor warnings.
# Assertion failures follow Zephyr's fatal-error handling by default.
CONFIG_ASSERT_LEVEL=2

# Override application INFO choices; include ERR/WRN/INF/DBG messages.
# Zephyr modules keep their own levels; printk redirection is unfiltered.
CONFIG_RADAR_MAIN_LOG_LEVEL_DBG=y
CONFIG_RADAR_UART_RX_LOG_LEVEL_DBG=y
CONFIG_RADAR_RX_PROCESSOR_LOG_LEVEL_DBG=y
CONFIG_RADAR_HANDLER_LOG_LEVEL_DBG=y
CONFIG_RADAR_UART_TX_LOG_LEVEL_DBG=y
```

## release.conf
```kconfig
# 릴리즈 빌드 오버레이 — assert 제거 + 속도 최적화 + 로그 최소화
CONFIG_ASSERT=n
CONFIG_SPEED_OPTIMIZATIONS=y
CONFIG_LOG_DEFAULT_LEVEL=2
```

## boards/stm32f746g_disco.overlay
```dts
/*
 * stm32f746g_disco.overlay
 *
 * HIL data link: USART6 on PC6 (TX) / PC7 (RX), 115200 8N1.
 * These pins are used with the external 3.3 V USB-UART adapter.
 *
 * Note: older comments in this project referenced PG9/PG14 (Arduino D0/D1),
 * but the working Zephyr pinctrl configuration for this board uses PC6/PC7.
 * USART1 remains available for the Zephyr console through the board's ST-Link VCP.
 */

&usart6 {
    pinctrl-0 = <&usart6_tx_pc6 &usart6_rx_pc7>;
    pinctrl-names = "default";
    current-speed = <115200>;
    status = "okay";
};
```

## src/main.c
```c
#include <zephyr/kernel.h>
#include <zephyr/logging/log.h>

#include "transport/uart_rx.h"
#include "transport/uart_tx.h"

LOG_MODULE_REGISTER(radar_main, CONFIG_RADAR_MAIN_LOG_LEVEL);

int main(void)
{
    // Console diagnostics are separate from USART6 protocol frames.
    LOG_INF("=== FCC learning-rebuild boot ===");

    // Prepare the transmit path before enabling reception.
    // These init APIs return 0 on success and a negative errno on failure.
    int ret = uart_tx_init();
    if (ret != 0) {
        return ret;
    }

    ret = uart_rx_init();
    if (ret != 0) {
        return ret;
    }

    LOG_INF("FCC ready: USART6 RX/TX initialized");

    // Keep the existing idle loop; periodic heartbeat output adds no tracking evidence.
    while (1) {
        k_sleep(K_SECONDS(1));
    }

    return 0;
}
```

## src/angle_utils.c
```c
#include "angle_utils.h"

#define PI_F 3.14159265358979323846f

float wrap_angle_rad(float angle)
{
    while (angle > PI_F) {
        angle -= 2 * PI_F;
    }

    while (angle <= -PI_F) {
        angle += 2 * PI_F;
    }

    return angle;
}

float angle_diff_rad(float a, float b)
{
    return wrap_angle_rad(a - b);
}
```

## src/angle_utils.h
```c
#ifndef ANGLE_UTILS_H
#define ANGLE_UTILS_H

float wrap_angle_rad(float angle);

float angle_diff_rad(float a, float b);


#endif
```

## src/crc16.c
```c
#include "crc16.h"

uint16_t crc16_update(uint16_t crc, const uint8_t byte)
{
    crc ^= (uint16_t)byte << 8;

    for (int i = 0; i < 8; ++i) {
        if (crc & 0x8000) {
            crc = (uint16_t)((crc << 1) ^ 0x1021);
        } else {
            crc = (uint16_t)(crc << 1);
        }
    }

    return crc;
}
```

## src/display.c
```c
/*
 * display.c — display 스레드 (LVGL)
 * F746G-DISCO 온보드 LCD에 HIL 상태판 렌더.
 * g_hil_stats(스냅샷)를 주기적으로 읽어 최신 측정값·프레임 카운터를
 * 멀티라인 라벨로 표시. 측정 전엔 "--", azimuth는 rad→deg 변환.
 */

#include "display.h"
#include "tracking.h"
#include <zephyr/kernel.h>
#include <zephyr/device.h>
#include <zephyr/drivers/display.h>
#include <zephyr/sys/printk.h>
#include <lvgl.h>
#include <stdio.h>
#include <math.h>

/* M_PI는 C 표준이 아닌 POSIX 확장 — libc(picolibc 등)가 기능 매크로 없이는
 * 노출 안 할 수 있어 방어적 폴백 정의. */
#ifndef M_PI
#define M_PI 3.14159265358979323846
#endif

#define RAD2DEG(r) ((r) * 180.0f / (float)M_PI)

void display_thread(void *p1, void *p2, void *p3)
{
    ARG_UNUSED(p1); ARG_UNUSED(p2); ARG_UNUSED(p3);

    const struct device *disp = DEVICE_DT_GET(DT_CHOSEN(zephyr_display));
    if (!device_is_ready(disp)) {
        printk("[display ] LCD 디바이스 미준비 — 렌더 중단\n");
        return;
    }

    /* 좌상단 정렬 멀티라인 라벨 1개
     * 주의: Zephyr v4.2는 LVGL v9를 번들함 — v8 이전 API인
     * lv_scr_act()/lv_task_handler()는 기본 설정(LV_USE_OBSOLETE_API=n)에서
     * 존재하지 않음. v9 API인 lv_screen_active()/lv_timer_handler() 사용. */
    lv_obj_t *label = lv_label_create(lv_screen_active());
    lv_obj_align(label, LV_ALIGN_TOP_LEFT, 8, 8);
    lv_label_set_text(label, "RADAR FCC (HIL)\nbooting...");

    display_blanking_off(disp);

    char buf[256];

    while (1) {
        /* 스냅샷 복사 (락 최소 구간) */
        struct hil_stats s;
        k_mutex_lock(&g_stats_mutex, K_FOREVER);
        s = g_hil_stats;
        k_mutex_unlock(&g_stats_mutex);

        if (s.has_meas) {
            snprintf(buf, sizeof(buf),
                     "RADAR FCC (HIL)\n"
                     "frames rx : %u\n"
                     "last meas\n"
                     "  t   : %u ms\n"
                     "  rng : %.1f m\n"
                     "  az  : %.1f deg\n"
                     "  dop : %.1f m/s\n"
                     "tracks: 0 (kalman TODO)",
                     s.frames_rx, s.last_ts_ms,
                     (double)s.last_range_m,
                     (double)RAD2DEG(s.last_azimuth_rad),
                     (double)s.last_doppler_mps);
        } else {
            snprintf(buf, sizeof(buf),
                     "RADAR FCC (HIL)\n"
                     "frames rx : 0\n"
                     "last meas\n"
                     "  t   : --\n"
                     "  rng : --\n"
                     "  az  : --\n"
                     "  dop : --\n"
                     "tracks: 0 (kalman TODO)");
        }
        lv_label_set_text(label, buf);

        lv_timer_handler();
        k_sleep(K_MSEC(100));
    }
}
```

## src/display.h
```c
#pragma once
/*
 * display.h — display 스레드 공개 인터페이스
 */

void display_thread(void *p1, void *p2, void *p3);
```

## src/frame.c
```c
/*
 * frame.c — HIL 바이너리 프레임 코덱 구현
 * Python protocol.py 의 crc16_ccitt / encode_frame / FrameParser 를 C로 포팅.
 */

#include "frame.h"
#include <zephyr/toolchain.h>
#include <string.h>

/* host 유닛테스트 이식성: 보드는 Zephyr __ASSERT, 그 외는 표준 assert */
#ifdef __ZEPHYR__
#include <zephyr/sys/__assert.h>
#else
#include <assert.h>
#define __ASSERT(cond, ...) assert(cond)
#endif

/* 페이로드 크기 컴파일 타임 검증 (Python struct calcsize 와 일치해야 함) */
BUILD_ASSERT(sizeof(FccMeasPayload)  == 20, "FccMeasPayload 크기 불일치");
BUILD_ASSERT(sizeof(FccTrackPayload) == 21, "FccTrackPayload 크기 불일치");
BUILD_ASSERT(sizeof(FccCtrlPayload)  ==  1, "FccCtrlPayload 크기 불일치");

/* ── CRC16-CCITT ──────────────────────────────────────────────────────────── */

uint16_t fcc_crc16(const uint8_t *data, uint16_t len)
{
    uint16_t crc = 0x0000U;

    for (uint16_t i = 0; i < len; i++) {
        crc ^= (uint16_t)data[i] << 8;
        for (int j = 0; j < 8; j++) {
            crc = (crc & 0x8000U)
                  ? (uint16_t)((crc << 1) ^ 0x1021U)
                  : (uint16_t)(crc << 1);
        }
    }
    return crc;
}

/* ── 프레임 인코더 ─────────────────────────────────────────────────────────── */

uint16_t fcc_encode_frame(uint8_t msg_type,
                          const uint8_t *payload, uint8_t payload_len,
                          uint8_t *buf, uint16_t buf_size)
{
    __ASSERT(buf != NULL, "fcc_encode_frame: buf is NULL");
    __ASSERT(payload_len <= FCC_MAX_PAYLOAD,
             "fcc_encode_frame: payload_len %u > max", payload_len);

    /* release(ASSERT=n)에서도 사는 하드 가드: crc_in 스택 오버런 방지 */
    if (payload_len > FCC_MAX_PAYLOAD) {
        return 0;
    }

    uint16_t total = 5U + payload_len;

    if (buf_size < total) {
        return 0;
    }

    /* CRC 입력: [LEN, TYPE, PAYLOAD...] */
    uint8_t crc_in[2U + FCC_MAX_PAYLOAD];
    crc_in[0] = payload_len;
    crc_in[1] = msg_type;
    memcpy(&crc_in[2], payload, payload_len);
    uint16_t crc = fcc_crc16(crc_in, 2U + payload_len);

    buf[0] = FCC_STX;
    buf[1] = payload_len;
    buf[2] = msg_type;
    memcpy(&buf[3], payload, payload_len);
    buf[3U + payload_len]     = (uint8_t)(crc >> 8);   /* CRC big-endian */
    buf[3U + payload_len + 1U] = (uint8_t)(crc & 0xFFU);

    return total;
}

/* ── FrameParser 상태머신 ─────────────────────────────────────────────────── */

void frame_parser_init(FrameParser *p)
{
    p->state   = FP_WAIT_STX;
    p->buf_idx = 0;
    p->len     = 0;
    p->msg_type = 0;
    p->crc_h   = 0;
}

void frame_parser_reset(FrameParser *p)
{
    p->state    = FP_WAIT_STX;
    p->buf_idx  = 0;
    p->len      = 0;
    p->msg_type = 0;
    p->crc_h    = 0;
}

bool frame_parser_feed(FrameParser *p, uint8_t b, FccFrame *out)
{
    __ASSERT(p != NULL, "frame_parser_feed: p is NULL");
    __ASSERT(out != NULL, "frame_parser_feed: out is NULL");

    switch (p->state) {

    case FP_WAIT_STX:
        if (b == FCC_STX) {
            p->state = FP_WAIT_LEN;
        }
        break;

    case FP_WAIT_LEN:
        if (b > FCC_MAX_PAYLOAD) {
            /* 비정상적으로 큰 LEN → 이 STX는 가비지, 재동기화 */
            p->state = FP_WAIT_STX;
        } else {
            p->len   = b;
            p->state = FP_WAIT_TYPE;
        }
        break;

    case FP_WAIT_TYPE:
        p->msg_type = b;
        p->buf_idx  = 0;
        p->state = (p->len > 0U) ? FP_WAIT_PAYLOAD : FP_WAIT_CRC_H;
        break;

    case FP_WAIT_PAYLOAD:
        __ASSERT(p->buf_idx < FCC_MAX_PAYLOAD,
                 "frame_parser_feed: buf overrun (idx=%u)", p->buf_idx);
        p->buf[p->buf_idx++] = b;
        if (p->buf_idx == p->len) {
            p->state = FP_WAIT_CRC_H;
        }
        break;

    case FP_WAIT_CRC_H:
        p->crc_h = b;
        p->state  = FP_WAIT_CRC_L;
        break;

    case FP_WAIT_CRC_L: {
        uint16_t received = ((uint16_t)p->crc_h << 8) | b;

        uint8_t crc_in[2U + FCC_MAX_PAYLOAD];
        crc_in[0] = p->len;
        crc_in[1] = p->msg_type;
        memcpy(&crc_in[2], p->buf, p->buf_idx);
        uint16_t expected = fcc_crc16(crc_in, 2U + p->buf_idx);

        p->state = FP_WAIT_STX;

        if (received == expected) {
            if (out != NULL) {
                out->msg_type    = p->msg_type;
                out->payload_len = p->buf_idx;
                memcpy(out->payload, p->buf, p->buf_idx);
            }
            return true;
        }
        /* CRC 불일치 → 프레임 버리고 재동기화 */
        break;
    }
    }

    return false;
}
```

## src/frame.h
```c
#pragma once
/*
 * frame.h — HIL 바이너리 프레임 코덱 (Zephyr 비의존, 순수 C)
 *
 * 프레임 포맷:  STX(1) | LEN(1) | TYPE(1) | PAYLOAD(LEN) | CRC16-BE(2)
 * CRC 범위: [LEN, TYPE, PAYLOAD...] (STX 제외)
 * 페이로드 엔디언: little-endian (ARM Cortex-M 기본)
 */

#include <stdbool.h>
#include <stdint.h>

/* ── 프레임 상수 ──────────────────────────────────────── */

#define FCC_STX          0x7EU

#define FCC_MSG_MEAS     0x01U  /* PC → STM32: 레이더 측정값 */
#define FCC_MSG_TRACK    0x02U  /* STM32 → PC: 트랙 상태 */
#define FCC_MSG_CTRL     0x03U  /* 양방향: 제어 명령 */

#define FCC_CTRL_START   0x01U
#define FCC_CTRL_STOP    0x02U
#define FCC_CTRL_RESET   0x03U

/* 현재 최대 페이로드 = TRACK 21바이트. 여유를 두어 64로 설정.
 * LEN > FCC_MAX_PAYLOAD 이면 해당 STX는 가비지로 간주 */
#define FCC_MAX_PAYLOAD  64U

/* ── 페이로드 구조체 ──────────────────────────────────── */
/* Python struct '<'(패딩 없음)과 동일 레이아웃을 위해 packed 필수 */

typedef struct __attribute__((packed)) {
    uint32_t timestamp_ms;
    float    range_m;
    float    azimuth_rad;
    float    elevation_rad;
    float    doppler_mps;
} FccMeasPayload;   /* 20바이트 */

typedef struct __attribute__((packed)) {
    uint32_t timestamp_ms;
    uint8_t  track_id;
    float    x_m;
    float    y_m;
    float    vx_mps;
    float    vy_mps;
} FccTrackPayload;  /* 21바이트 */

typedef struct __attribute__((packed)) {
    uint8_t cmd;
} FccCtrlPayload;   /* 1바이트 */

/* ── CRC16-CCITT (XModem: poly=0x1021, init=0x0000) ──── */

uint16_t fcc_crc16(const uint8_t *data, uint16_t len);

/* ── 프레임 인코더 ───────────────────────────────────── */
/* buf에 완성된 프레임을 기록. 반환값: 프레임 총 바이트 수 (실패 시 0) */
uint16_t fcc_encode_frame(uint8_t msg_type,
                          const uint8_t *payload, uint8_t payload_len,
                          uint8_t *buf, uint16_t buf_size);

/* ── FrameParser 상태머신 ───────────────────────────── */

typedef enum {
    FP_WAIT_STX = 0,
    FP_WAIT_LEN,
    FP_WAIT_TYPE,
    FP_WAIT_PAYLOAD,
    FP_WAIT_CRC_H,
    FP_WAIT_CRC_L,
} FpState;

typedef struct {
    FpState  state;
    uint8_t  len;
    uint8_t  msg_type;
    uint8_t  buf[FCC_MAX_PAYLOAD];
    uint8_t  buf_idx;
    uint8_t  crc_h;
} FrameParser;

typedef struct {
    uint8_t msg_type;
    uint8_t payload[FCC_MAX_PAYLOAD];
    uint8_t payload_len;
} FccFrame;

void frame_parser_init(FrameParser *p);
void frame_parser_reset(FrameParser *p);

/* 바이트 1개를 파서에 공급. 프레임 완성 시 out을 채우고 true 반환. */
bool frame_parser_feed(FrameParser *p, uint8_t byte, FccFrame *out);
```

## src/frame_handler.c
```c
#include <zephyr/sys/printk.h>
#include <zephyr/kernel.h>

#include "frame_handler.h"
#include "radar_message.h"
#include "gating.h"
#include "rx_frame_processor.h"

// Expire the track after 1000 ms without a decoded and validated radar measurement.
#define RADAR_RX_TIMEOUT_MS 1000

static void frame_handler_thread(void *p_arg1, void *p_arg2, void *p_arg3);

static void handle_radar_measurement(struct frame_handler *p_handler, const struct received_frame *p_frame);
static void update_track_from_measurement(struct track *p_track, const struct radar_measurement *p_measurement);

K_THREAD_DEFINE(frame_handler_tid, 2048, frame_handler_thread, NULL, NULL, NULL, 6, 0, 0);

K_MSGQ_DEFINE(frame_queue, sizeof(struct received_frame), 8, 4);

void frame_handler_init(struct frame_handler *p_handler) 
{
    track_init(&p_handler->track);

    // Arm timeout monitoring only after the next valid radar measurement.
    p_handler->last_valid_rx_ms = 0;
    p_handler->timeout_armed = false;
}

static void frame_handler_thread(void *p_arg1, void *p_arg2, void *p_arg3)
{
    ARG_UNUSED(p_arg1);
    ARG_UNUSED(p_arg2);
    ARG_UNUSED(p_arg3);

    // Initialize handler state before processing queued frames.
    struct frame_handler handler;
    struct received_frame frame;

    frame_handler_init(&handler);

    while (1) {
        int ret = k_msgq_get(&frame_queue, &frame, K_MSEC(50));

        if (ret == 0) {
            // Process the recieved frame here.
            handle_frame(&handler, &frame);
        }

        frame_handler_check_timeout(&handler, k_uptime_get());
    }
}


void frame_handler_reset(struct frame_handler *p_handler) 
{
    frame_handler_init(p_handler);
}

void frame_handler_check_timeout(struct frame_handler *p_handler, int64_t now_ms)
{
    // No timeout before the first valid measurement after initialization or reset.
    if (!p_handler->timeout_armed) {
        return;
    }

    // Both times use board uptime in ms, not the sender's measurement timestamp.
    const int64_t elapsed_ms = now_ms - p_handler->last_valid_rx_ms;

    if (elapsed_ms < RADAR_RX_TIMEOUT_MS) {
        return;
    }

    // Clear the stale track and disarm monitoring so this timeout is logged once.
    frame_handler_reset(p_handler);
    printk("Radar measurement timeout: track cleared\n");
}

void handle_frame(struct frame_handler *p_handler, const struct received_frame *p_r_frame)
{
    switch (p_r_frame->frame.type) {
    case TYPE_INIT:
        printk("TYPE_INIT\n");
        frame_handler_init(p_handler);
        break;

    case TYPE_RADAR_MEAS: {
        printk("TYPE_MEAS\n");
        handle_radar_measurement(p_handler, p_r_frame);
        break;
    }
    case TYPE_STATUS:
        printk("TYPE_STATUS\n");
        struct rx_frame_stats stats;
        rx_frame_processor_get_stats(&stats);
        printk("CRC: %u, length: %u, timeout: %u, queue drops: %u\n",
            (unsigned int)stats.crc_errors,
            (unsigned int)stats.length_errors,
            (unsigned int)stats.frame_timeouts,
            (unsigned int)stats.queue_drops);
        break;

    case TYPE_COMMAND:
        printk("TYPE_COMMAND\n");
        break;

    case TYPE_RESET:
        printk("TYPE RESET\n");
        frame_handler_reset(p_handler);
        break;
    default:
        printk("Unknown frame type: 0x%02X\n", p_r_frame->frame.type);
        break;
    }
}

static void handle_radar_measurement(struct frame_handler *p_handler, const struct received_frame *p_r_frame)
{
    struct radar_measurement rm;

    if (!decode_radar_measurement(
            p_r_frame->frame.payload,
            p_r_frame->frame.payload_length,
            &rm)) {
        printk("Invalid radar payload\n");
        return;
    }

    if (!validate_radar_measurement(&rm)) {
        printk("Invalid radar measurement\n");
        return;
    }

    // Record received time for valid radar payloads, before timestamp/gate checks.
    // A later tracking rejection still counts as receiving a valid measurement payload.
    p_handler->last_valid_rx_ms = p_r_frame->received_at_ms;
    p_handler->timeout_armed = true;

    printk("range: %.2f\n", (double)rm.range_m);
    printk("azimuth: %.2f\n", (double)rm.azimuth_rad);

    update_track_from_measurement(&p_handler->track, &rm);
    
}

static void update_track_from_measurement(struct track *p_track, const struct radar_measurement *p_measurement)
{
    if (p_track->state == TRACK_EMPTY) {            
        track_start(p_track, (float)p_measurement->range_m, (float)p_measurement->azimuth_rad, p_measurement->timestamp_ms);
        
        printk("Filters initialized at range: %.2f\n", (double)p_measurement->range_m);
        printk("Filters initialized at azimuth: %.2f\n", (double)p_measurement->azimuth_rad);
    } else {

        if(!track_predict(p_track, p_measurement->timestamp_ms)) {
            printk("Invalid measurement interval\n");
            return;
        }

        const float predicted_range = p_track->range_filter.estimate;
        const float predicted_azimuth = p_track->azimuth_filter.estimate;
        
        printk("predicted range: %.2f\n", (double)predicted_range);
        printk("predicted azimuth: %.2f\n", (double)predicted_azimuth);

        // Gating
        const bool is_in_gate = gating_check(
            p_measurement->range_m,
            predicted_range,
            p_measurement->azimuth_rad,
            predicted_azimuth
        );

        // Correction
        if (is_in_gate) {
            track_hit(p_track, p_measurement->range_m, p_measurement->azimuth_rad);
            printk("Measurement accepted\n");
        } else {
            track_miss(p_track);
            printk("Measurement rejected by gate\n");
        }

        const float filtered_range =
            p_track->range_filter.estimate;

        const float filtered_azimuth =
            p_track->azimuth_filter.estimate;


        printk("filtered range: %.2f\n",
            (double)filtered_range);

        printk("filtered azimuth: %.2f\n",
            (double)filtered_azimuth);

        printk("estimated range rate: %.2f\n",
            (double)p_track->range_filter.rate);
        printk("estimated azimuth rate: %.2f\n",
            (double)p_track->azimuth_filter.rate);
    }
}

int frame_handler_submit(const struct received_frame *p_frame)
{
    if (p_frame == NULL || !protocol_frame_is_valid(&p_frame->frame)) {
        return -EINVAL;
    }

    return k_msgq_put(&frame_queue, p_frame, K_NO_WAIT);
}
```

## src/frame_handler.h
```c
#ifndef FRAME_HANDLER_H
#define FRAME_HANDLER_H

#include <stdint.h>
#include <stdbool.h>

#include "track.h"
#include "protocol_frame.h"

struct frame_handler {
    struct track track;
    // Board uptime (ms) when the last decoded and validated radar measurement was processed.
    int64_t last_valid_rx_ms; 
    // Set by a valid radar measurement; cleared by initialization or timeout reset.
    bool timeout_armed;
};

struct received_frame {
    struct protocol_frame frame;
    int64_t received_at_ms;
};

void frame_handler_init(struct frame_handler *p_handler);
void frame_handler_reset(struct frame_handler *p_handler);
void frame_handler_check_timeout(struct frame_handler *p_handler, int64_t now_ms);



void handle_frame(struct frame_handler *p_handler, const struct received_frame *p_frame);

int frame_handler_submit(const struct received_frame *p_frame);


#endif
```

## src/frame_parser.c
```c
#include "frame_parser.h"

static bool frame_crc_is_valid(const struct frame_parser *p_parser);

void parser_init(struct frame_parser *p_parser) {
    p_parser->state = WAIT_STX;
    p_parser->frame.payload_length = 0;
    p_parser->frame.type = 0;
    p_parser->payload_index = 0;
}

ParserResult parser_feed(struct frame_parser *p_parser, uint8_t byte) {
    switch (p_parser->state) {
    case WAIT_STX:
        if (byte == STX) {
            p_parser->state = WAIT_LEN;
        }
        break;
    case WAIT_LEN:
        if (byte == 0 || byte > MAX_PAYLOAD) {
            p_parser->state = WAIT_STX;
            return PARSER_LENGTH_ERROR;
        } else {
            p_parser->frame.payload_length = byte;
            p_parser->state = WAIT_TYPE;
        }
        break;
    case WAIT_TYPE:
        p_parser->frame.type = byte;
        p_parser->state = READ_PAYLOAD;
        break;
    case READ_PAYLOAD:
        p_parser->frame.payload[p_parser->payload_index++] = byte;
        if (p_parser->payload_index == p_parser->frame.payload_length) {
            p_parser->state = WAIT_CRC_H;
        }
        break;
    case WAIT_CRC_H:
        p_parser->received_crc = (uint16_t)byte << 8;

        p_parser->state = WAIT_CRC_L;
        break;
    case WAIT_CRC_L:
        p_parser->received_crc |= byte;

        const bool valid = frame_crc_is_valid(p_parser);

        p_parser->state = WAIT_STX;
        p_parser->payload_index = 0;

        return valid? PARSER_FRAME_READY: PARSER_CRC_ERROR;
    }
    return PARSER_INCOMPLETE;
}

static bool frame_crc_is_valid(const struct frame_parser *p_parser)
{
    return protocol_frame_crc(&p_parser->frame) == p_parser->received_crc;
}
```

## src/frame_parser.h
```c
#ifndef FRAME_PARSER_H
#define FRAME_PARSER_H

#include <stdbool.h>
#include <stdint.h>

#include "protocol_frame.h"

#define STX 0x7E

typedef enum {
    WAIT_STX,
    WAIT_LEN,
    WAIT_TYPE,
    READ_PAYLOAD,
    WAIT_CRC_H,
    WAIT_CRC_L
} ParserState;

typedef enum {
    PARSER_INCOMPLETE,
    PARSER_FRAME_READY,
    PARSER_CRC_ERROR,
    PARSER_LENGTH_ERROR,
} ParserResult;

struct frame_parser {
    ParserState state;
    struct protocol_frame frame;
    uint8_t payload_index;
    uint16_t received_crc;
};

void parser_init(struct frame_parser *p_parser);
ParserResult parser_feed(struct frame_parser *p_parser, uint8_t byte);

#endif
```

## src/gating.c
```c
#include "gating.h"
#include "angle_utils.h"

#include <math.h>

#define PI_F 3.14159265358979323846f

#define RANGE_GATE_M       100.0f
#define AZIMUTH_GATE_RAD    (10.0f * PI_F / 180.0f)

bool gating_check(
    float measured_range,
    float predicted_range,
    float measured_azimuth,
    float predicted_azimuth)
{
    const float range_error =
        measured_range - predicted_range;

    const float azimuth_error =
        angle_diff_rad(
            measured_azimuth,
            predicted_azimuth);

    return
        fabsf(range_error) <= RANGE_GATE_M &&
        fabsf(azimuth_error) <= AZIMUTH_GATE_RAD;
}
```
